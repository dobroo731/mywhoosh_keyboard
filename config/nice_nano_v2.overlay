/ {
    chosen {
        zmk,kscan = &kscan0;
    };

    kscan0: kscan_composite {
        compatible = "zmk,kscan-gpio-direct";
        label = "KSCAN";
        input-gpios
            = <&gpio0 6  (GPIO_ACTIVE_LOW | GPIO_PULL_UP)> // Кнопка 1
            , <&gpio0 8  (GPIO_ACTIVE_LOW | GPIO_PULL_UP)> // Кнопка 2
            , <&gpio0 17 (GPIO_ACTIVE_LOW | GPIO_PULL_UP)> // Кнопка 3
            , <&gpio0 20 (GPIO_ACTIVE_LOW | GPIO_PULL_UP)> // Кнопка 4
            , <&gpio0 22 (GPIO_ACTIVE_LOW | GPIO_PULL_UP)> // Кнопка 5
            , <&gpio0 24 (GPIO_ACTIVE_LOW | GPIO_PULL_UP)> // Кнопка 6
            , <&gpio1 0  (GPIO_ACTIVE_LOW | GPIO_PULL_UP)> // Кнопка 7
            , <&gpio0 11 (GPIO_ACTIVE_LOW | GPIO_PULL_UP)> // Кнопка 8
            , <&gpio1 4  (GPIO_ACTIVE_LOW | GPIO_PULL_UP)> // Кнопка 9
            , <&gpio1 6  (GPIO_ACTIVE_LOW | GPIO_PULL_UP)> // Кнопка 10
            , <&gpio0 9  (GPIO_ACTIVE_LOW | GPIO_PULL_UP)> // Кнопка 11
            , <&gpio0 10 (GPIO_ACTIVE_LOW | GPIO_PULL_UP)> // Кнопка 12
            , <&gpio1 11 (GPIO_ACTIVE_LOW | GPIO_PULL_UP)> // Кнопка 13
            , <&gpio1 13 (GPIO_ACTIVE_LOW | GPIO_PULL_UP)> // Кнопка 14
            , <&gpio1 15 (GPIO_ACTIVE_LOW | GPIO_PULL_UP)> // Кнопка 15
            , <&gpio0 29 (GPIO_ACTIVE_LOW | GPIO_PULL_UP)> // Кнопка 16 (Новая)
            , <&gpio0 2  (GPIO_ACTIVE_LOW | GPIO_PULL_UP)> // Кнопка 17 (Новая)
            , <&gpio1 10 (GPIO_ACTIVE_LOW | GPIO_PULL_UP)> // Кнопка 18 (Новая)
            ;
    };
};
